## meta-arduino-qcom/conf/local.conf.sample
```bitbake
MACHINE ??= "imola"
DISTRO ?= "qcom-distro"
USER_CLASSES ?= "buildstats"
#PATCHRESOLVE = "noop"

BB_DISKMON_DIRS ??= "\
    STOPTASKS,${TMPDIR},1G,100K \
    STOPTASKS,${DL_DIR},1G,100K \
    STOPTASKS,${SSTATE_DIR},1G,100K \
    STOPTASKS,/tmp,100M,100K \
    HALT,${TMPDIR},100M,1K \
    HALT,${DL_DIR},100M,1K \
    HALT,${SSTATE_DIR},100M,1K \
    HALT,/tmp,10M,1K"

MIRRORS:append = " \
    git://github.com git://git.codelinaro.org/clo/yocto-mirrors/github/ \
    git://.*/ git://git.codelinaro.org/clo/yocto-mirrors/ \
    https://.*/.*/ https://artifacts.codelinaro.org/codelinaro-le/ \
"

KERNEL_CMDLINE_EXTRA:append = " qcom_scm.download_mode=1"

#IMAGE_CLASSES += "image_types_qcom"
#IMAGE_FSTYPES += "qcomflash"

#DISTRO_FEATURES:append = " efi pam pni-names"
#EXTRA_IMAGE_FEATURES = "allow-empty-password empty-root-password allow-root-login"
IMAGE_ROOTFS_EXTRA_SPACE = "307200"
#WATCHDOG_RUNTIME_SEC:pn-systemd = "30"

INHERIT:remove = "uninative"

BB_SIGNATURE_HANDLER = "OEBasicHash"

#INHERIT += "buildstats-summary"
#INHERIT += "buildhistory"
INHERIT += "rm_work"
#INHERIT += "image-buildinfo"

SKIP_META_QCOM_SANITY_CHECK = "1"

CONF_VERSION = "2"
```

## meta-arduino-qcom/conf/machine/imola.conf
```bitbake
#@TYPE: Machine
#@NAME: Arduino Imola (Arduino UNO Q)
#@SOC: Qualcomm QRB2210
#@DESCRIPTION: Machine configuration for Arduino Imola (Arduino UNO Q) board based on Qualcomm QRB2210 SoC and STM32 microcontroller.
#@MAINTAINER: Massimo Pennazio <maxipenna@libero.it>

require conf/machine/uno-q.conf

MACHINEOVERRIDES =. "uno-q:"

# Override the variables you want to change here
KERNEL_CMDLINE_EXTRA:append = "${@bb.utils.contains('PREFERRED_KERNEL', 'linux-qcom-next-rt', ' isolcpus=2,3 nohz_full=2,3 rcu_nocbs=2,3 irqaffinity=0-1 rcupdate.rcu_expedited=1 cpuidle.off=1', '', d)}"

# Arduino core configuration
ARDUINO_CORE_VERSION ?= "0.55.0"
ARDUINO_CORE ?= "arduino:zephyr@${ARDUINO_CORE_VERSION}"
ARDUINO_ZEPHYR_LOADER ?= "zephyr-arduino_uno_q_stm32u585xx"
# The sketch to be flashed on the board. You can change this to point to your own sketch. Path is relative to the arduino-core directory.
ARDUINO_SKETCH ?= "Reflash_Bootanimation.ino"
ARDUINO_SKETCH_PATH ?= "libraries/Arduino_LED_Matrix/examples/Reflash_Bootanimation/${ARDUINO_SKETCH}"
# Dependencies for the Sketch. You can add more dependencies here if your sketch requires them.
ARDUINO_SKETCH_LIBS ?= "ArduinoGraphics Arduino_RouterBridge"
MACHINE_ESSENTIAL_EXTRA_RRECOMMENDS += "arduino-firmware"
MACHINE_ESSENTIAL_EXTRA_RRECOMMENDS += "arduino-router"
```
